;Matrix handling

.section .text

.global getMatrix
; r24: index for the matrix
; return in r24 the value
; change r24, r30, r31
getMatrix:
    mov r30, r24
    ldi r31, 0
    subi r30, lo8(-(matrix))
    sbci r31, hi8(-(matrix))
    ld r24, Z
    ret

.global setMatrix
; r24: index, r22: data to set  (init from main.S)
; change r30, r31
setMatrix:
	mov r30, r24		;r30 <- index
	ldi r31, 0
	subi r30, lo8(-(matrix))
	sbci r31, hi8(-(matrix))
	st Z, r22
	ret


.global copy
; (r24,r25): the address of the matrix to copy from
; (r22,r23): the address of the matrix to copy to
; change r18, r21, r28, r29, r30, r31
copy:
	ldi r21, 0                     ; r21 loop index

	mov r30, r24
	mov r31, r25
	mov r28, r22
	mov r29, r23
	copyLoop:
		ld r18, Z+
		st Y+, r18

		inc r21                   ; loop handling
		cpi r21, 16               ;
		brlt copyLoop             ;
	ret

.global print
;prints (r24,r25)
print:
	ldi r20, 0                     ; r20 loop index

	mov r30, r24
	mov r31, r25
	printLoop:
		mov r24, r20

		ld r24, Z+
		call USART_send

		inc r20			             ; loop handling
		cpi r20, 16                  ;
		brlt printLoop               ;
	ret


.global transpose
; (r24,r25): the address of the matrix to transpose
; change r20, r21, r22, r23, r28, r29, r30, r31
transpose:
    mov r30, r24
    mov r31, r25
    mov r28, r24
    mov r29, r25
    ldi r22, 0              ;i
    lineLoop:
        ldi r23, 0          ;j
        columnLoop:
            ; set Z to the first case
            ldi r21, 4      ;(i*4)
            mul r22, r21
            mov r21, r0
            push r30
            push r31
            add r30, r23
            adc r31, 0      ;??? add with carry 0
            add r30, r21
            adc r31, 0      ;??? add with carry 0

            ;set Y to the other case
            ldi r21, 4      ;(j*4)
            mul r23, r21
            mov r21, r0
            push r28
            push r29
            add r28, r22
            adc r29, 0      ;??? add with carry 0
            add r28, r21
            adc r29, 0      ;??? add with carry 0

            ld r20, Y       ;load from Y to r20
            ; swap r20 and data from Z
            ld r19, Z       
            st Z, r20
            st Y, r19

            pop r29
            pop r28
            pop r31
            pop r30
            inc r23         ;j+=1
            cp r23, r22
            brlt columnLoop
        inc r22             ;i+=1
        cpi r22, 4
        brlt lineLoop
    ret



.global subByte
; r24: byte to substitue
; return in r24 the substitued byte
; change r24, r30, r31
subByte:
    mov r30, r24                ; load Z = array index
    ldi r31, 0                  ; ...high byte of index is 0
    subi r30, lo8(-(SBOX))  ; subtract -(address of my array)
    sbci r31, hi8(-(SBOX))  ; ...high byte also
    ld r24, Z
    ret

.global getRCON
; r24: index for the RCON matrix
; return in r24 RCON value
; change r24, r30, r31
getRCON:
    mov r30, r24
    ldi r31, 0
    subi r30, lo8(-(RCON))
    sbci r31, hi8(-(RCON))
    ld r24, Z
    ret

.global getRoundKey
; r24: index for the roundKey
; return in r24 the value
; change r24, r30, r31
getRoundKey:
    mov r30, r24
    ldi r31, 0
    subi r30, lo8(-(roundKey))
    sbci r31, hi8(-(roundKey))
    ld r24, Z
    ret

.global setRoundKey
; r24: index for the roundKey matrix, r22 value to set
; change r30, r31
setRoundKey:
    mov r30, r24
    ldi r31, 0
    subi r30, lo8(-(roundKey))
    sbci r31, hi8(-(roundKey))
    st Z, r22
    ret

.global getTmv
; r24: index for tmv array
; return in r24 the value
; change r24, r30, r31
getTmv:
    mov r30, r24
    ldi r31, 0
    subi r30, lo8(-(tmv))
    sbci r31, hi8(-(tmv))
    ld r24, Z
    ret

.global setTmv
; r24: index for tmv, r22 value to set
; change r30, r31
setTmv:
    mov r30, r24
    ldi r31, 0
    subi r30, lo8(-(tmv))
    sbci r31, hi8(-(tmv))
    st Z, r22
    ret

.global getTest
; r24: index for test array
; return in r24 the value
; change r24, r30, r31
getTest:
    mov r30, r24
    ldi r31, 0
    subi r30, lo8(-(test))
    sbci r31, hi8(-(test))
    ld r24, Z
    ret

.global setTest
; r24: index for test, r22 value to set
; change r30, r31
setTest:
    mov r30, r24
    ldi r31, 0
    subi r30, lo8(-(test))
    sbci r31, hi8(-(test))
    st Z, r22
    ret


.global getInitialData
; r24: index for initialData array
; return in r24 the value
; change r24, r30, r31
getInitialData:
    mov r30, r24
    ldi r31, 0
    subi r30, lo8(-(initialData))
    sbci r31, hi8(-(initialData))
    ld r24, Z
    ret

.global setInitialData
; r24: index for initialData, r22 value to set
; change r30, r31
setInitialData:
    mov r30, r24
    ldi r31, 0
    subi r30, lo8(-(initialData))
    sbci r31, hi8(-(initialData))
    st Z, r22
    ret


.global tpt
tpt:
    push r24
    push r25
    call transpose
    call print
    pop r25
    pop r24
    call transpose
    ret

.macro DEBUG m
    push r24
    push r25
    ldi r24, lo8(\m)
    ldi r25, hi8(\m)
    call tpt
    pop r24
    pop r25
.endm

.global subByte1
; r24: byte to substitue
; return in r24 the substitued byte
; change r24, r30, r31
subByte1:
    mov r30, r24                ; load Z = array index
    ldi r31, 0                  ; ...high byte of index is 0
    subi r30, lo8(-(SBOX1))  ; subtract -(address of my array)
    sbci r31, hi8(-(SBOX1))  ; ...high byte also
    ld r24, Z
    ret

.global subByte2
; r24: byte to substitue
; return in r24 the substitued byte
; change r24, r30, r31
subByte2:
    mov r30, r24                ; load Z = array index
    ldi r31, 0                  ; ...high byte of index is 0
    subi r30, lo8(-(SBOX2))  ; subtract -(address of my array)
    sbci r31, hi8(-(SBOX2))  ; ...high byte also
    ld r24, Z
    ret

.global subByte3
; r24: byte to substitue
; return in r24 the substitued byte
; change r24, r30, r31
subByte3:
    mov r30, r24                ; load Z = array index
    ldi r31, 0                  ; ...high byte of index is 0
    subi r30, lo8(-(SBOX3))  ; subtract -(address of my array)
    sbci r31, hi8(-(SBOX3))  ; ...high byte also
    ld r24, Z
    ret

.global subByte4
; r24: byte to substitue
; return in r24 the substitued byte
; change r24, r30, r31
subByte4:
    mov r30, r24                ; load Z = array index
    ldi r31, 0                  ; ...high byte of index is 0
    subi r30, lo8(-(SBOX4))  ; subtract -(address of my array)
    sbci r31, hi8(-(SBOX4))  ; ...high byte also
    ld r24, Z
    ret


.global getMdsMatrix
; r24: index for the mds_matrix
; return in r24 the value
; change r24, r30, r31
getMdsMatrix:
    mov r30, r24
    ldi r31, 0
    subi r30, lo8(-(mds_matrix))
    sbci r31, hi8(-(mds_matrix))
    ld r24, Z
    ret

.section .data

.global SBOX
.type   SBOX, @object
.size SBOX, 256
SBOX: .byte 0x63, 0x7C, 0x77, 0x7B, 0xF2, 0x6B, 0x6F, 0xC5, 0x30, 0x01, 0x67, 0x2B, 0xFE,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 0x16

.type RCON, @object
.size RCON, 10
RCON: .byte 0x01, 0x02, 0x04, 0x08, 0x10, 0x20, 0x40, 0x80, 0x1b, 0x36

.global matrix
.type matrix, @object
.size matrix, 16
matrix: .byte 0x10, 0x11, 0x12, 0x13, 0x14, 0x15, 0x16, 0x17, 0x18, 0x19, 0x1A, 0x1B, 0x1C, 0x1D, 0x1E, 0x1F

.global state
.type state, @object
.size state, 16
state: .byte 0x05, 0x00, 0x00, 0x00, 0x00, 0x00, 0x00, 0x00, 0x00, 0x00, 0x00, 0x00, 0x00, 0x00, 0x00, 0x00

.global tmpState
.type tmpState, @object
.size tmpState, 16
tmpState: .byte 0x00, 0x00, 0x00, 0x00, 0x00, 0x00, 0x00, 0x00, 0x00, 0x00, 0x00, 0x00, 0x00, 0x00, 0x00, 0x00


.global roundKey
.type roundKey, @object
.size roundKey, 176
roundKey: .byte 0x00, 0x00, 0x00, 0x00, 0x00, 0x00, 0x00, 0x00, 0x00, 0x00, 0x00, 0x00, 0x00,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 0x00


.global SBOX1
.type   SBOX1, @object
.size SBOX1, 256
SBOX1: .byte 0xa8, 0x43, 0x5f, 0x06, 0x6b, 0x75, 0x6c, 0x59, 0x71, 0xdf, 0x87, 0x95, 0x17,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 0x80

.global SBOX2
.type   SBOX2, @object
.size SBOX2, 256
SBOX2: .byte 0xce, 0xbb, 0xeb, 0x92, 0xea, 0xcb, 0x13, 0xc1, 0xe9, 0x3a, 0xd6, 0xb2, 0xd2,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 0xd7

.global SBOX3
.type   SBOX3, @object
.size SBOX3, 256
SBOX3: .byte 0x93, 0xd9, 0x9a, 0xb5, 0x98, 0x22, 0x45, 0xfc, 0xba, 0x6a, 0xdf, 0x02, 0x9f,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 0x67

.global SBOX4
.type   SBOX4, @object
.size SBOX4, 256
SBOX4: .byte 0x68, 0x8d, 0xca, 0x4d, 0x73, 0x4b, 0x4e, 0x2a, 0xd4, 0x52, 0x26, 0xb3, 0x54,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 0x61

.global mds_matrix
.type mds_matrix, @object
.size mds_matrix, 64
mds_matrix: .byte 0x01, 0x01, 0x05, 0x01, 0x08, 0x06, 0x07, 0x04, 0x04, 0x01, 0x01, 0x05, 0x01,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 0x01

.global ktRound
.type ktRound, @object
.size ktRound, 16
ktRound: .byte 0x00, 0x00, 0x00, 0x00, 0x00, 0x00, 0x00, 0x00, 0x00, 0x00, 0x00, 0x00, 0x00, 0x00, 0x00, 0x00

.global initialData
.type initialData, @object
.size initialData, 16
initialData: .byte 0x00, 0x00, 0x00, 0x00, 0x00, 0x00, 0x00, 0x00, 0x00, 0x00, 0x00, 0x00, 0x00, 0x00, 0x00, 0x00

.global tmv
.type tmv, @object
.size tmv, 16
tmv: .byte 0x00, 0x00, 0x00, 0x00, 0x00, 0x00, 0x00, 0x00, 0x00, 0x00, 0x00, 0x00, 0x00, 0x00, 0x00, 0x00

.global test
.type test, @object
.size test, 16
test: .byte 0x00, 0x00, 0x00, 0x00, 0x00, 0x00, 0x00, 0x00, 0x00, 0x00, 0x00, 0x00, 0x00, 0x00, 0x00, 0x00
